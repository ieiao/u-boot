## arch/mips/mach-loongson/Kconfig
```kconfig
menu "Loongson platforms"
	depends on ARCH_LOONGSON

config SYS_TEXT_BASE
	default 0x80000000

choice
	prompt "Loongson SoC select"

config LS1C
	bool "Loongson ls1c"
	select SUPPORTS_CPU_MIPS32_R1
	select SUPPORTS_CPU_MIPS32_R2
	help
	  This supports Loongson ls1c SoC.

endchoice

choice
	prompt "Board select"

config TARGET_LS1C_GENERIC
	bool "ls1c generic board"
	depends on LS1C
	help
	  This supports ls1c generic board.

endchoice

source "board/loongson/ls1c_generic/Kconfig"

endmenu
```

## board/loongson/ls1c_generic/Kconfig
```kconfig
if TARGET_LS1C_GENERIC

config SYS_BOARD
	default "ls1c_generic"

config SYS_VENDOR
	default "loongson"

config SYS_CONFIG_NAME
	default "loongson_ls1c"

endif
```

## configs/loongson_ls1c_defconfig
```kconfig
CONFIG_MIPS=y
CONFIG_SKIP_LOWLEVEL_INIT=y
CONFIG_SYS_MALLOC_F_LEN=0x4000
CONFIG_ENV_SIZE=0x2000
CONFIG_ENV_OFFSET=0x80000
CONFIG_ENV_SECT_SIZE=0x100
CONFIG_DEFAULT_DEVICE_TREE="loongson,ls1c_generic"
CONFIG_ARCH_LOONGSON=y
CONFIG_MIPS_MACH_EARLY_INIT=y
CONFIG_RESTORE_EXCEPTION_VECTOR_BASE=y
CONFIG_MIPS_BOOT_FDT=y
CONFIG_SYS_LOAD_ADDR=0x80200000
# CONFIG_ARCH_FIXUP_FDT_MEMORY is not set
CONFIG_SYS_CONSOLE_ENV_OVERWRITE=y
CONFIG_HUSH_PARSER=y
# CONFIG_BOOTM_NETBSD is not set
# CONFIG_BOOTM_PLAN9 is not set
# CONFIG_BOOTM_RTEMS is not set
# CONFIG_BOOTM_VXWORKS is not set
# CONFIG_CMD_FLASH is not set
CONFIG_CMD_MTD=y
CONFIG_CMD_PART=y
# CONFIG_CMD_SOURCE is not set
# CONFIG_CMD_SETEXPR is not set
CONFIG_CMD_TIME=y
CONFIG_CMD_FAT=y
CONFIG_OF_LIVE=y
CONFIG_OF_EMBED=y
CONFIG_ENV_IS_IN_SPI_FLASH=y
CONFIG_ENV_ADDR=0x80000
# CONFIG_NET is not set
# CONFIG_I2C is not set
# CONFIG_INPUT is not set
CONFIG_MTD=y
CONFIG_DM_MTD=y
CONFIG_DM_SPI_FLASH=y
# CONFIG_SPI_FLASH_UNLOCK_ALL is not set
CONFIG_SPI_FLASH_GIGADEVICE=y
CONFIG_SPI_FLASH_WINBOND=y
CONFIG_SPI_FLASH_MTD=y
CONFIG_SPECIFY_CONSOLE_INDEX=y
CONFIG_CONS_INDEX=0
CONFIG_DM_SERIAL=y
CONFIG_SYS_NS16550=y
CONFIG_SPI=y
CONFIG_LOONGSON_SPI=y
CONFIG_SYSRESET=y
CONFIG_SYSRESET_WATCHDOG=y
# CONFIG_WATCHDOG is not set
# CONFIG_WATCHDOG_AUTOSTART is not set
CONFIG_WATCHDOG_TIMEOUT_MSECS=5000
CONFIG_WDT_LS1C=y
CONFIG_FS_EXT4=y
CONFIG_REGEX=y
CONFIG_HEXDUMP=y
```
