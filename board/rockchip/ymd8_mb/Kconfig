## board/rockchip/ymd8_mb/Kconfig
```kconfig
if TARGET_YMD8_MB

config SYS_BOARD
	default "ymd8_mb"

config SYS_VENDOR
	default "rockchip"

config SYS_CONFIG_NAME
	default "ymd8_mb"

endif
```

## configs/ymd8-mb_defconfig
```kconfig
CONFIG_ARM=y
CONFIG_SKIP_LOWLEVEL_INIT=y
CONFIG_COUNTER_FREQUENCY=24000000
CONFIG_ARCH_ROCKCHIP=y
CONFIG_TEXT_BASE=0x00200000
CONFIG_SYS_MALLOC_F_LEN=0x1000
CONFIG_NR_DRAM_BANKS=1
CONFIG_HAS_CUSTOM_SYS_INIT_SP_ADDR=y
CONFIG_CUSTOM_SYS_INIT_SP_ADDR=0x300000
CONFIG_DEFAULT_DEVICE_TREE="rk3368-ymd8-mb"
CONFIG_DM_RESET=y
CONFIG_ROCKCHIP_RK3368=y
CONFIG_TARGET_YMD8_MB=y
CONFIG_SYS_LOAD_ADDR=0x800800
CONFIG_DEBUG_UART_BASE=0xFF690000
CONFIG_DEBUG_UART_CLOCK=24000000
CONFIG_DEBUG_UART=y
# CONFIG_EFI_LOADER is not set
CONFIG_FDT_SIMPLEFB=y
CONFIG_DEFAULT_FDT_FILE="rockchip/rk3368-ymd8-mb.dtb"
# CONFIG_CONSOLE_MUX is not set
# CONFIG_SYS_DEVICE_NULLDEV is not set
# CONFIG_DISPLAY_CPUINFO is not set
CONFIG_DISPLAY_BOARDINFO_LATE=y
# CONFIG_CYCLIC is not set
CONFIG_LAST_STAGE_INIT=y
CONFIG_CMD_PWM=y
CONFIG_CMD_MMC=y
CONFIG_CMD_BMP=y
# CONFIG_CMD_CLS is not set
CONFIG_CMD_REGULATOR=y
CONFIG_NO_NET=y
CONFIG_REGMAP=y
CONFIG_SYSCON=y
CONFIG_CLK=y
CONFIG_ROCKCHIP_GPIO=y
CONFIG_SYS_I2C_ROCKCHIP=y
CONFIG_MMC_DW=y
CONFIG_MMC_DW_ROCKCHIP=y
CONFIG_DM_ETH_PHY=y
CONFIG_PHY_ROCKCHIP_INNO_DSIDPHY=y
CONFIG_PINCTRL=y
CONFIG_DM_PMIC=y
CONFIG_PMIC_RK8XX=y
CONFIG_REGULATOR_PWM=y
CONFIG_DM_REGULATOR_FIXED=y
CONFIG_DM_REGULATOR_GPIO=y
CONFIG_REGULATOR_RK8XX=y
CONFIG_PWM_ROCKCHIP=y
CONFIG_RAM=y
CONFIG_DEBUG_UART_SHIFT=2
CONFIG_SYS_NS16550_MEM32=y
CONFIG_SYSRESET=y
CONFIG_VIDEO=y
# CONFIG_VIDEO_DAMAGE is not set
CONFIG_BACKLIGHT_GPIO=y
# CONFIG_SIMPLE_PANEL is not set
CONFIG_VIDEO_LCD_RM72014=y
CONFIG_DISPLAY=y
CONFIG_VIDEO_ROCKCHIP=y
CONFIG_VIDEO_ROCKCHIP_MAX_XRES=1280
CONFIG_VIDEO_ROCKCHIP_MAX_YRES=1920
CONFIG_DISPLAY_ROCKCHIP_MIPI=y
CONFIG_DISPLAY_ROCKCHIP_DW_MIPI=y
CONFIG_VIDEO_BRIDGE=y
CONFIG_SPLASH_SCREEN=y
CONFIG_SPLASH_SCREEN_ALIGN=y
CONFIG_HIDE_LOGO_VERSION=y
CONFIG_SPLASH_SOURCE=y
CONFIG_VIDEO_BMP_RLE8=y
CONFIG_BMP_16BPP=y
CONFIG_BMP_24BPP=y
CONFIG_BMP_32BPP=y
# CONFIG_FAT_WRITE is not set
CONFIG_REGEX=y
CONFIG_ERRNO_STR=y
```
